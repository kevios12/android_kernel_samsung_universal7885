## arch/arm64/Kconfig.exynos
```kconfig
config MACH_EXYNOS7885_A40_GLOBAL
	bool "Build dtbo image for SM-A405"
	depends on SOC_EXYNOS7885
	default n
	help
	Say Y here if you want to enable building dtbo for Galaxy A40.

config MACH_EXYNOS7885_JACKPOTLTE_GLOBAL
	bool "Build dummy dtbo image for A8 2018"
	depends on SOC_EXYNOS7885
	default y
	help
	Say Y here if you want to enable building dtbo for Galaxy A8 2018.

config MACH_EXYNOS7885_JACKPOT2LTE_GLOBAL
	bool "Build dummy dtbo image for A8+ 2018"
	depends on SOC_EXYNOS7885
	default n
	help
	Say Y here if you want to enable building dtbo for Galaxy A8 2018.

config USE_STOCK_CONFIG_FOR_IKCONFIG
	bool "Use stock config for /proc/config.gz"
	depends on IKCONFIG
	default y
	help
	  Say Y here to use stock OEM unmodified defconfig for /proc/config.gz
```
