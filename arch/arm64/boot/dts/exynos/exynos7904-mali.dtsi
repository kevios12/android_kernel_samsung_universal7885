/*
 * SAMSUNG EXYNOS7904 SoC device tree source
 *
 * Copyright (c) 2018 Samsung Electronics Co., Ltd.
 *		http://www.samsung.com
 *
 * This program is free software; you can redistribute it and/or modify
 * it under the terms of the GNU General Public License version 2 as
 * published by the Free Software Foundation.
*/

&mali {
	interactive_info = <1001000 95 0>;
	gpu_dvfs_table_size = <8 7>; /*<row col>*/
	                /* clk     min max  down mif_min  lit_min big_max */
	gpu_dvfs_table = < 1300000 98  100  1    2002000  1586000 0
	                   1200000 98  100  1    2002000  1586000 0
	                   1100000 90  100  1    2002000  1586000 0
	                   1001000 90   95  1    1794000  1586000 0
	                    845000 90   95  1    1794000  1586000 0
	                    676000 85   90  1    1014000   902000 0
	                    545000 85   90  1     845000   839000 0
	                    450000 85   90  1     845000   839000 0 >;
	gpu_max_clock = <1100000>;
	gpu_max_clock_limit = <1100000>;
	gpu_temp_throttling_level_num = <6>;
	gpu_temp_throttling = <1001000 845000 676000 545000 450000 450000>;
};
